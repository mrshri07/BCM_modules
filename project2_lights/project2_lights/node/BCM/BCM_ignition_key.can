/*@!Encoding:65001*/
includes
{
  
}

variables
{
  message ignition_Message ign_ipt;
  message power_window_Message power_window_ipt;
 
  message 0x4 mirr_messa;
  
  int ignition_key;
  int power_window;
   int left_DRL;
     int i;
   int wiper_washer;
  int wiper_flag;
  int wiper_increment;
  int power_flag;
  msTimer ignition_timer;
  msTimer int_wiper_washer_timer;
   msTimer low_wiper_washer_timer;
 msTimer high_wiper_washer_timer;
  msTimer power_window_timer;
  msTimer power_window_up_timer;
   msTimer power_window_down_timer;
  //int a[9]= {0,1,2,3,4,5,6,7,8};
  int power_down_up;
  int p[9] ={0,1,2,3,4,5,6,7,8};
  int position;
  int power_window_down;

 
 // const mask =0x0E;

  int folding;

}
//on sysvar ignition_key::ignition_key
//{
//  switch(@ignition_key::ignition_key)
//  {
//    case 1:
//      ignition_key=1;
//      @left_DRL::left_DRL=1;
//      @right_DRL::right_DRL=1;
//      write("accessary");
    
//    break;
//    case 2:
//      ignition_key=2;
//      write("ON");;
//    break;
//    case 3:
//      ignition_key=3;
//        write("start");
//    break; 
//   default:
//      ignition_key=0;
//       @left_DRL::left_DRL=0;
//      @right_DRL::right_DRL=0;
//      @head_light_swt::head_light_swt=0;
//      @position_light::position_light=0;
//      @low_beam_light::low_beam_light=0;
//      @high_beam_light::high_beam_light=0;
//      @left_direction_light::left_direction_light=0;
//      @right_direction_light::right_direction_light=0;
//      @direction_swt::direction_swt=0;
//      @hazard_swt::hazard_swt=0;
//      @wiper_washer::wiper_washer=0;
//      @right_controle_swt::right_controle_swt=0;
//      @left_controle_swt::left_controle_swt=0;
//      @up_controle_swt::up_controle_swt=0;
//      @down_controle_swt::down_controle_swt=0;
//        write("lock");
    
//  }
//}

on sysvar ignition_key::ignition_key
{
  if(@ignition_key::ignition_key==1)
  {
    ignition_key=1;
      @left_DRL::left_DRL=1;
      @right_DRL::right_DRL=1;
      write("accessary");
  }
 else if(@ignition_key::ignition_key==2)
  {
     ignition_key=2;
      write("ON");
  }
  
 else if(@ignition_key::ignition_key==3)
  {
     ignition_key=3;
        write("start");
  }
  else
  {
    ignition_key=0;
       @left_DRL::left_DRL=0;
      @right_DRL::right_DRL=0;
      @head_light_swt::head_light_swt=0;
      @position_light::position_light=0;
      @low_beam_light::low_beam_light=0;
      @high_beam_light::high_beam_light=0;
      @left_direction_light::left_direction_light=0;
      @right_direction_light::right_direction_light=0;
      @direction_swt::direction_swt=0;
      @hazard_swt::hazard_swt=0;
      @wiper_washer::wiper_washer=0;
      @right_controle_swt::right_controle_swt=0;
      @left_controle_swt::left_controle_swt=0;
      @up_controle_swt::up_controle_swt=0;
      @down_controle_swt::down_controle_swt=0;
        write("lock");
    
    
  }
  
}






on timer ignition_timer
{
  ign_ipt.ignition_Signal=ignition_key;
  output(ign_ipt);
}


on message wiper_washer_Message
{
  if(@ignition_key::ignition_key==1)
  {
  if(this.wiper_washer_Signal==1)
  {
     wiper_washer=1;//intermitant
  
    
  }
  else if(this.wiper_washer_Signal==2)
  {
     wiper_washer=2;//low
  
  }
  else if(this.wiper_washer_Signal==3)
  {
     wiper_washer=3;//high
  
  }
  else{
    wiper_washer=0;//off
 
  }
}
}

on timer int_wiper_washer_timer
{  //if($ignition_Signal==1)
  if($wiper_washer_Signal==1)
  if(wiper_flag==0)
  {
    @wiper_washer_stetus::wiper_washer_stetus ++;
    if(@wiper_washer_stetus::wiper_washer_stetus==3)
    
      wiper_flag=1;
  }
   
    else if (wiper_flag==1)
    {
       @wiper_washer_stetus::wiper_washer_stetus --;
       if(@wiper_washer_stetus::wiper_washer_stetus==0)
       
      wiper_flag=0;
       
    }
  
  setTimerCyclic(int_wiper_washer_timer,700);
}
on timer low_wiper_washer_timer
{  //if($ignition_Signal==1)
  if($wiper_washer_Signal==2)
  if(wiper_flag==0)
  {
    @wiper_washer_stetus::wiper_washer_stetus ++;
    if(@wiper_washer_stetus::wiper_washer_stetus==3)
    
      wiper_flag=1;
  }
   
    else if (wiper_flag==1)
    {
       @wiper_washer_stetus::wiper_washer_stetus --;
       if(@wiper_washer_stetus::wiper_washer_stetus==0)
       
      wiper_flag=0;
       
    }
  
  setTimerCyclic(low_wiper_washer_timer,500);
}
on timer high_wiper_washer_timer
{  //if($ignition_Signal==1)
  if($wiper_washer_Signal==3)
  if(wiper_flag==0)
  {
    @wiper_washer_stetus::wiper_washer_stetus ++;
    if(@wiper_washer_stetus::wiper_washer_stetus==3)
    
      wiper_flag=1;
  }
   
    else if (wiper_flag==1)
    {
       @wiper_washer_stetus::wiper_washer_stetus --;
       if(@wiper_washer_stetus::wiper_washer_stetus==0)
       
      wiper_flag=0;
       
    }
  
  setTimerCyclic(high_wiper_washer_timer,100);
}


on sysvar power_window_swt_up::power_window_swt_up
{
  if($ignition_Signal==1)
  if(@power_window_swt_up::power_window_swt_up==1)
  {
   power_down_up=1;
  }

  else{
   power_down_up=0;
  }
}
on sysvar power_window_down::power_window_down
{
  if($ignition_Signal==1)
  if(@power_window_down::power_window_down==1)
  {
    power_window_down=1;
  }
  else{
      power_window_down=0;
  }
}

on timer power_window_timer
{
  power_window_ipt.power_window_up_Signal= power_down_up;
   power_window_ipt.power_window_down_Signal=   power_window_down;
  output(power_window_ipt);
}


on timer power_window_up_timer
{
 if($ignition_Signal==1)
   //int a[9]= {0,1,2,3,4,5,6,7,8};
 if($power_window_up_Signal==1)
 {
   if(@power_window_states::power_window_states >p[0] )
   {
     @power_window_states::power_window_states --;
   }
 }
 setTimer(power_window_up_timer,100);
}
on timer power_window_down_timer
{
   if($ignition_Signal==1)
  if($power_window_down_Signal==1)
  {
    if(@power_window_states::power_window_states <p[7])
    {
      @power_window_states::power_window_states++;
    }
  }
  setTimer(power_window_down_timer,100);
}


//side view mirror
//on message 0x4
//{
//  if(((this.byte(0)&0xE0)>>5)==1)
//  {

//     @folding_states::folding_states=1;//unfolding
//     if(((word)(this.word(0)&0x38>>11)==0)|(this.word(0)&0x38>>11)==2)
//     {
//        if((this.byte(0)&0x07>>0)==1)
//        {
//          @up_control_states::up_control_states=1;
//        }
//        else if((this.byte(0)&0x07>>0)==2)
//        {
//          @down_control_states::down_control_states=1;
//        }
//        else if((this.byte(0)&0x07>>0)==3)
//        {
//          @left_control_states::left_control_states=1;
//        }
//        else if((this.byte(0)&0x07>>0)==4)
//        {
//          @right_control_states::right_control_states=1;
//        }
//        else
//        {
//          @up_control_states::up_control_states=0;
//          @down_control_states::down_control_states=0;
//          @left_control_states::left_control_states=0;
//          @right_control_states::right_control_states=0;
//        }
  
//     }
//  }
//  else
//  {
//    @folding_states::folding_states=0;
//  }
//}

on message 0x4 
{
  if(((this.byte(0)& 0x70)>>4)==1)
  //if((word)(this.word(0)&0x70>>4)==1)
  {
    @folding_states::folding_states=1;
    if(((this.byte(0)& 0x07)==0)|(this.byte(0)& 0x07)==2)
    {
      if(((word)(this.word(0)&0x3800)>>11)==1)
      {
        @up_control_states::up_control_states=1;
        write("up side");
      }
      else if(((word)(this.word(0)&0x3800)>>11)==2)
      {
        @down_control_states::down_control_states=1;
        write("down side");
      }
      else if(((word)(this.word(0)&0x3800)>>11)==3)
      {
        @left_control_states::left_control_states=1;
      }
       else if(((word)(this.word(0)&0x3800)>>11)==4)
      {
        @right_control_states::right_control_states=1;
      }
      else
      {
         @up_control_states::up_control_states=0;
         @down_control_states::down_control_states=0;
         @left_control_states::left_control_states=0;
        @right_control_states::right_control_states=0;
      }
      
    }
  }
  else
  {
    @folding_states::folding_states=0;
  }
}


on start      
{
  setTimerCyclic(ignition_timer,200);
 setTimerCyclic(int_wiper_washer_timer,700);
  setTimerCyclic(low_wiper_washer_timer,500);
   setTimerCyclic(high_wiper_washer_timer,100);
  setTimerCyclic( power_window_timer,200);
 setTimer(power_window_up_timer,100);
  setTimer(power_window_down_timer,100);

}

