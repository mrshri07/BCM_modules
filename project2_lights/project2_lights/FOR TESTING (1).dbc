VERSION ""

NS_ :

BS_:

BU_: engine_Node_3 power_transmission_mode_Node_2 BCM_Node_1
VAL_TABLE_ engine_Value_Table_4 3 "not available" 2 "error" 1 "off" 0 "ON" ;
VAL_TABLE_ brake_input_Value_Table_3 3 "not available" 2 "error" 1 "brake unpress" 0 "brake press" ;
VAL_TABLE_ gare_input_Value_Table_2 8 "not available" 7 "error" 6 "reverse gare" 5 "fifth gare" 4 "fourth gare" 3 "third gare" 2 "second gare" 1 "first gare" 0 "neutral" ;
VAL_TABLE_ vehicle_power_mode_Value_Table_1 5 "not available" 4 "error" 3 "start" 2 "ON" 1 "accessary" 0 "lock" ;

BO_ 0 engine_input_Message_4: 1 engine_Node_3
 SG_ engine_Signal_4 : 0|3@1+ (1,0) [0|3] "" Vector__XXX

BO_ 4 brake_input_Message_3: 1 power_transmission_mode_Node_2
 SG_ brake_input_Signal_3 : 0|3@1+ (1,0) [0|3] "" Vector__XXX

BO_ 3 gare_input_Message_2: 1 power_transmission_mode_Node_2
 SG_ gare_input_Signal_2 : 0|4@1+ (1,0) [0|8] "" Vector__XXX

BO_ 2 vehicle_power_mode_Message_1: 1 BCM_Node_1
 SG_ vehicle_power_mode_Signal_1 : 0|1@1+ (1,0) [0|5] "" Vector__XXX

BA_DEF_ BO_  "GenMsgSendType" ENUM  "Cyclic","NotUsed","NotUsed","NotUsed","NotUsed","NotUsed","NotUsed","IfActive","NoMsgSendType","NotUsed";
BA_DEF_ SG_  "GenSigSendType" ENUM  "Cyclic","OnWrite","OnWriteWithRepetition","OnChange","OnChangeWithRepetition","IfActive","IfActiveWithRepetition","NoSigSendType","NotUsed","NotUsed","NotUsed","NotUsed","NotUsed";
BA_DEF_  "Baudrate" INT 0 1000000;
BA_DEF_  "BusType" STRING ;
BA_DEF_  "NmType" STRING ;
BA_DEF_  "Manufacturer" STRING ;
BA_DEF_  "VersionMonth" INT 1 12;
BA_DEF_  "VersionDay" INT 1 31;
BA_DEF_  "Version" STRING ;
BA_DEF_ BO_  "VFrameFormat" ENUM  "StandardCAN","ExtendedCAN","reserved","J1939PG";
BA_DEF_ BO_  "SingleFrame" INT 0 1;
BA_DEF_ SG_  "SigType" ENUM  "Default","Range","RangeSigned","ASCII","Discrete","Control","ReferencePGN","DTC","StringDelimiter","StringLength","StringLengthControl";
BA_DEF_  "SAE_J1939-73_SpecVersion" STRING ;
BA_DEF_  "ProtocolType" STRING ;
BA_DEF_ BU_  "NmStationAddress" INT 0 255;
BA_DEF_  "NmAsrWaitBusSleepTime" INT 0 65535;
BA_DEF_  "NmAsrTimeoutTime" INT 0 65535;
BA_DEF_  "NmAsrRepeatMessageTime" INT 0 65535;
BA_DEF_ BU_  "NmAsrNode" ENUM  "No","Yes";
BA_DEF_  "NmAsrMessageCount" INT 1 256;
BA_DEF_  "NmAsrCanMsgCycleTime" INT 0 65535;
BA_DEF_  "NmAsrBaseAddress" HEX 0 536870911;
BA_DEF_ SG_  "GenSigILSupport" ENUM  "Yes","No";
BA_DEF_ SG_  "GenSigEVName" STRING ;
BA_DEF_ BO_  "GenMsgRequestable" INT 0 1;
BA_DEF_ BO_  "GenMsgILSupport" ENUM  "No","Yes";
BA_DEF_  "DBName" STRING ;
BA_DEF_ BO_  "CanTpFcFrameId" HEX 0 2147483647;
BA_DEF_ BO_  "CanTpBs" INT 0 255;
BA_DEF_DEF_  "GenMsgSendType" "Cyclic";
BA_DEF_DEF_  "GenSigSendType" "Cyclic";
BA_DEF_DEF_  "Baudrate" 500000;
BA_DEF_DEF_  "BusType" "";
BA_DEF_DEF_  "NmType" "";
BA_DEF_DEF_  "Manufacturer" "VOLVO_AB";
BA_DEF_DEF_  "VersionMonth" 1;
BA_DEF_DEF_  "VersionDay" 1;
BA_DEF_DEF_  "Version" "-";
BA_DEF_DEF_  "VFrameFormat" "J1939PG";
BA_DEF_DEF_  "SingleFrame" 1;
BA_DEF_DEF_  "SigType" "Default";
BA_DEF_DEF_  "SAE_J1939-73_SpecVersion" "";
BA_DEF_DEF_  "ProtocolType" "";
BA_DEF_DEF_  "NmStationAddress" 254;
BA_DEF_DEF_  "NmAsrWaitBusSleepTime" 750;
BA_DEF_DEF_  "NmAsrTimeoutTime" 1000;
BA_DEF_DEF_  "NmAsrRepeatMessageTime" 300;
BA_DEF_DEF_  "NmAsrNode" "Yes";
BA_DEF_DEF_  "NmAsrMessageCount" 256;
BA_DEF_DEF_  "NmAsrCanMsgCycleTime" 200;
BA_DEF_DEF_  "NmAsrBaseAddress" 486506496;
BA_DEF_DEF_  "GenSigILSupport" "Yes";
BA_DEF_DEF_  "GenSigEVName" "Env@Nodename_@Signame";
BA_DEF_DEF_  "GenMsgRequestable" 1;
BA_DEF_DEF_  "GenMsgILSupport" "Yes";
BA_DEF_DEF_  "DBName" "";
BA_DEF_DEF_  "CanTpFcFrameId" 2147483647;
BA_DEF_DEF_  "CanTpBs" 255;
BA_ "Manufacturer" "DPIT";
BA_ "NmType" "CAN";
BA_ "BusType" "CAN";
BA_ "Baudrate" 250000;
BA_ "ProtocolType" "CAN";
BA_ "VersionMonth" 8;
BA_ "VersionDay" 16;
BA_ "SAE_J1939-73_SpecVersion" "*";
BA_ "Version" "*";
BA_ "DBName" "Light_proj_1";
BA_ "VFrameFormat" BO_ 0 0;
BA_ "VFrameFormat" BO_ 4 0;
BA_ "VFrameFormat" BO_ 3 0;
BA_ "VFrameFormat" BO_ 2 0;
VAL_ 0 engine_Signal_4 3 "not available" 2 "error" 1 "off" 0 "ON" ;
VAL_ 4 brake_input_Signal_3 3 "not available" 2 "error" 1 "brake unpress" 0 "brake press" ;
VAL_ 3 gare_input_Signal_2 3 "not available" 2 "error" 1 "off" 0 "ON" ;
VAL_ 2 vehicle_power_mode_Signal_1 5 "not available" 4 "error" 3 "start" 2 "ON" 1 "accessary" 0 "lock" ;
